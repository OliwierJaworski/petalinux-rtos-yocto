## petalinux-base-pynqZ2/PYNQ_SDL/project-spec/configs/configs/Kconfig
```kconfig
mainmenu "PetaLinux System Configuration"
config SUBSYSTEM_TYPE_LINUX
        bool
        default y
        select SYSTEM_ZYNQ

config SYSTEM_ZYNQ
        bool "ZYNQ Configuration"
        help
          ZYNQ Configuration for petalinux project.
          All these config options will be in /home/laptop_oli/Github/petalinux-rtos-yocto/petalinux-sdl2-pynqZ2/PYNQ_SDL/project-spec/configs/config

config SUBSYSTEM_DISTRO_PETALINUX
        bool
        default y
        help

source /home/laptop_oli/Github/petalinux-rtos-yocto/petalinux-sdl2-pynqZ2/PYNQ_SDL/project-spec/configs/configs/Kconfig.main
```

## petalinux-yocto/linux-images/pynq_vdma_game/project-spec/configs/rootfsconfigs/Kconfig.user
```kconfig
menu "user packages " 
config libsdl2  
	 bool "libsdl2"
	 help
	
config gpio-demo  
	 bool "gpio-demo"
	 help
	
config peekpoke  
	 bool "peekpoke"
	 help
	
config xf86-video-fbdev  
	 bool "xf86-video-fbdev"
	 help
	
endmenu
```

## platforms/pynq_vdma_game/project-spec/configs/rootfsconfigs/Kconfig.user
```kconfig
menu "user packages " 
config libsdl2  
	 bool "libsdl2"
	 help
	
config gpio-demo  
	 bool "gpio-demo"
	 help
	
config peekpoke  
	 bool "peekpoke"
	 help
	
endmenu
```
